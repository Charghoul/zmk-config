## config/west.yml
```yaml
manifest:
  remotes:
    - name: Charghoul
      url-base: https://github.com/Charghoul
  projects:
    - name: zmk
      remote: Charghoul
      revision: main
      import: app/west.yml
  self:
    path: config
```
